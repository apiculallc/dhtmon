## main/Kconfig.projbuild
```kconfig
menu "ESP DHT Config"

    config ESP_MAXIMUM_RETRY
        int "Maximum retry"
        default 5
        help
        Set the Maximum retry to avoid station reconnecting to the AP unlimited when the AP is really inexistent.

    config APP_MQTT_TOPIC
        string "MQTT topic name"
        default "/home/sensor/%s"
        help
        Unique ID of the device.

endmenu
```
